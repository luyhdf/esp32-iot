## main/Kconfig.projbuild
```kconfig
menu "Example Configuration"

    config BROKER_URI
        string "Broker URL"
        default "MQTT://{IoTCoreId}.iot.{Region}.baidubce.com"
        help
            URL of an mqtt broker which this example connects to.

    config BROKER_USERNAME
        string "Broker Username"
        default ""

    config BROKER_PASSWORD
        string "Broker Password"
        default ""

    config BROKER_CLINT_ID
        string "Broker Clint ID"
        default ""

    config BROKER_CERTIFICATE_OVERRIDE
        string "Server certificate override"
        default ""
        help
            Please leave empty if server certificate included from a textfile; otherwise fill in a base64 part of PEM
            format certificate

    config BROKER_CERTIFICATE_OVERRIDDEN
        bool
        default y if BROKER_CERTIFICATE_OVERRIDE != ""

endmenu
```
